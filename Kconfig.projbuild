## Kconfig.projbuild
```kconfig
menu "ESP IDF Timeseries Configuration"

    config TIMESERIES_USE_SERIES_ID_CACHE
        bool "Enable Series ID Cache"
        default y
        help
            Enable the in-memory series ID cache to speed up repeated inserts
            to the same series. This significantly improves performance for
            workloads that repeatedly write to the same measurement/field
            combinations. Disable this to save memory if you have many
            unique series.

    config TIMESERIES_SERIES_ID_CACHE_SIZE
        int "Series ID Cache Size"
        depends on TIMESERIES_USE_SERIES_ID_CACHE
        range 8 256
        default 64
        help
            Number of series IDs to cache in memory. Each entry uses approximately
            150 bytes of RAM. Larger values improve cache hit rate but use more memory.
            Recommended values:
            - 16-32 for memory-constrained systems
            - 64 for typical use cases
            - 128-256 for systems with many series

    config TIMESERIES_CACHE_USE_LRU
        bool "Use LRU eviction policy"
        depends on TIMESERIES_USE_SERIES_ID_CACHE
        default y
        help
            Use Least Recently Used (LRU) eviction policy for the series ID cache.
            When disabled, uses a simple round-robin replacement policy which is
            faster but less effective.

    config TIMESERIES_ENABLE_CACHE_STATS
        bool "Enable cache statistics"
        depends on TIMESERIES_USE_SERIES_ID_CACHE
        default n
        help
            Track and log cache hit/miss statistics. Useful for tuning cache size
            and monitoring performance. Adds minimal overhead.

    config TIMESERIES_CHUNK_BUFFER_SIZE
        int "Initial chunk write buffer size (KB)"
        range 4 64
        default 16
        help
            Initial size of the pre-allocated buffer for chunk writes.
            This buffer will grow as needed but starts at this size.
            Larger values reduce reallocations but use more memory.

    config TIMESERIES_ALP_CHUNK_MAX_POINTS
        int "Maximum points per ALP compaction record"
        range 16 65535
        default 1024
        help
            Maximum number of data points written into a single ALP-encoded
            field_data record during compaction. The on-disk record_count field
            is uint16_t, so 65535 is the hard upper limit. Lowering this value
            causes the compaction code to split large series into multiple
            consecutive records (chunking). This value also controls the peak
            RAM used during compaction: the encoder allocates two arrays of
            this many int64/double values (~16 bytes per point). At 1024 points
            the peak allocation is ~16 KB for inputs plus ~18 KB for the encoded
            output buffers — acceptable for ESP32 targets without PSRAM. Raising
            this reduces the number of ALP records per series but increases
            transient RAM use proportionally up to an effective cap of 1024
            points. Larger configuration values remain accepted, but the
            compactor caps its input buffers at 1024 points. String records
            also have a separate byte budget to bound retained string data.
            Test builds may set a lower value (e.g. 200) to exercise chunking
            with small datasets.

    menu "Free space and retention"

        choice TIMESERIES_WHEN_FULL
            prompt "When the partition is full"
            default TIMESERIES_WHEN_FULL_DROP_OLDEST
            help
                What an insert does when no space is left for it.

            config TIMESERIES_WHEN_FULL_DROP_OLDEST
                bool "Drop the oldest data"
                help
                    Keep recording: delete the oldest data to make room. A
                    background task also clears the oldest data before free
                    space runs out (TIMESERIES_CLEAR_FREE_KB), so inserts
                    rarely wait for it.

            config TIMESERIES_WHEN_FULL_STOP
                bool "Stop recording"
                help
                    Keep all stored data; inserts fail once the partition is
                    full, until the application expires or deletes data.
        endchoice

        config TIMESERIES_INSERT_RESERVE_KB
            int "Free space inserts leave for maintenance (KB)"
            range 16 1024
            default 64
            help
                An insert does not take a new page if that would leave less
                than this much usable free space (free runs of at least
                16 KB). Compaction and expiration need it to make space.
                Capped at 1/8 of the partition.

        config TIMESERIES_MAINTENANCE_RESERVE_KB
            int "Free space compaction leaves for expiration (KB)"
            range 0 1024
            default 32
            help
                Compaction does not take a page if that would leave less than
                this much usable free space. Expiration may use it. Keep it
                below TIMESERIES_INSERT_RESERVE_KB. Capped at 1/16 of the
                partition.

        config TIMESERIES_CLEAR_FREE_KB
            int "Clear the oldest data below this much free space (KB)"
            depends on TIMESERIES_WHEN_FULL_DROP_OLDEST
            range 0 65536
            default 128
            help
                The background task expires the oldest data when usable free
                space falls below this. 0 leaves clearing to inserts that
                find no space. Capped at 1/4 of the partition.

        config TIMESERIES_MAX_USAGE_PERCENT
            int "Expire the oldest data above this usage (%)"
            depends on TIMESERIES_WHEN_FULL_DROP_OLDEST
            range 0 99
            default 0
            help
                The background task also expires the oldest data while more
                than this share of the partition is used. A fuller partition
                erases its flash more often; a lower limit trades capacity
                for flash life. 0 disables the limit.

    endmenu

endmenu
```

## test_host/memsafety_2026_09_23/sdkconfig.defaults
```kconfig
CONFIG_PARTITION_TABLE_CUSTOM=y
CONFIG_PARTITION_TABLE_CUSTOM_FILENAME="../../test_app/partitions.csv"
CONFIG_IDF_TARGET="linux"
CONFIG_FREERTOS_THREAD_LOCAL_STORAGE_POINTERS=2
CONFIG_ESP_MAIN_TASK_STACK_SIZE=32768
CONFIG_TIMESERIES_USE_SERIES_ID_CACHE=y
CONFIG_TIMESERIES_SERIES_ID_CACHE_SIZE=64
CONFIG_TIMESERIES_CACHE_USE_LRU=y
CONFIG_TIMESERIES_CHUNK_BUFFER_SIZE=16
CONFIG_TIMESERIES_ALP_CHUNK_MAX_POINTS=1024
```

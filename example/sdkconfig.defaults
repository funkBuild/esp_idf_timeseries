## example/sdkconfig.defaults
```kconfig
# ESP IDF Timeseries Configuration
CONFIG_TIMESERIES_USE_SERIES_ID_CACHE=y
CONFIG_TIMESERIES_SERIES_ID_CACHE_SIZE=64
CONFIG_TIMESERIES_CACHE_USE_LRU=y
CONFIG_TIMESERIES_ENABLE_CACHE_STATS=y
CONFIG_TIMESERIES_CHUNK_BUFFER_SIZE=16
```
